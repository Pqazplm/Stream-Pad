#include <HID-Project.h> 
#include <Wire.h>
#include <Adafruit_GFX.h>
#include <Adafruit_SSD1306.h>

#define SCREEN_WIDTH 128
#define SCREEN_HEIGHT 64
#define OLED_RESET    -1 
Adafruit_SSD1306 display(SCREEN_WIDTH, SCREEN_HEIGHT, &Wire, OLED_RESET);

#define POT_PIN A1 

// Ваши актуальные пины
#define BUTTON_PIN1 9 // Бывший pin5 -> теперь это Кнопка 1 (выдаст KEY_1)
#define BUTTON_PIN2 8 // Бывший pin3 -> теперь это Кнопка 2 (выдаст KEY_2)
#define BUTTON_PIN3 5 // Бывший pin4 -> теперь это Кнопка 3 (выдаст KEY_3)
#define BUTTON_PIN4 6 // Бывший pin6 -> теперь это Кнопка 4 (выдаст KEY_4)
#define BUTTON_PIN5 4 // Бывший pin2 -> теперь это Кнопка 5 (выдаст KEY_5)
#define BUTTON_PIN6 7 // Бывший pin1 -> теперь это Кнопка 6 (выдаст KEY_6)

const int NUM_PROFILES = 3; 
int currentProfile = 0;     

// Битмапы (иконки оставьте свои)
// Вы можете заменить эти массивы на свои через сайт image2cpp
const unsigned char icon_game [] PROGMEM = {
  0x00, 0x00, 0x00, 0x00, 0x00, 0x00, 0x00, 0x00, 0x00, 0x00, 0x00, 0x00, 0x00, 0x00, 0x00, 0x00,
  0x00, 0x00, 0x00, 0x00, 0x00, 0x00, 0x00, 0x00, 0x03, 0xf0, 0x0f, 0xc0, 0x07, 0xf8, 0x1f, 0xe0,
  0x0f, 0xff, 0xff, 0xf0, 0x1f, 0xff, 0xff, 0xf8, 0x3f, 0xff, 0xff, 0xfc, 0x7f, 0xfe, 0x7f, 0xfe,
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  0x00, 0x00, 0x00, 0x00, 0x00, 0x00, 0x00, 0x00, 0x00, 0x00, 0x00, 0x00, 0x00, 0x00, 0x00, 0x00
};

const unsigned char icon_work [] PROGMEM = {
  0x00, 0x00, 0x00, 0x00, 0x00, 0x00, 0x00, 0x00, 0x00, 0x00, 0x00, 0x00, 0x00, 0x7f, 0xfe, 0x00, 
  0x00, 0x7f, 0xfe, 0x00, 0x00, 0x60, 0x06, 0x00, 0x00, 0x60, 0x06, 0x00, 0x3f, 0xff, 0xff, 0xfc, 
  0x7f, 0xff, 0xff, 0xfe, 0x7f, 0xff, 0xff, 0xfe, 0x7f, 0xff, 0xff, 0xfe, 0x7f, 0xff, 0xff, 0xfe, 
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  0x00, 0x00, 0x00, 0x00, 0x00, 0x00, 0x00, 0x00, 0x00, 0x00, 0x00, 0x00, 0x00, 0x00, 0x00, 0x00
};

const unsigned char icon_art [] PROGMEM = {
  0x00, 0x00, 0x00, 0x00, 0x00, 0x08, 0x10, 0x00, 0x00, 0x1c, 0x38, 0x00, 0x00, 0x3e, 0x7c, 0x00, 
  0x00, 0x7e, 0x7e, 0x00, 0x00, 0xfe, 0x7f, 0x00, 0x01, 0xfe, 0x7f, 0x80, 0x03, 0xfe, 0x7f, 0xc0, 
  0x07, 0xfe, 0x7f, 0xe0, 0x0f, 0xfe, 0x7f, 0xf0, 0x1f, 0xfe, 0x7f, 0xf8, 0x3f, 0xfe, 0x7f, 0xfc, 
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  0x00, 0x00, 0x00, 0x00, 0x00, 0x00, 0x00, 0x00, 0x00, 0x00, 0x00, 0x00, 0x00, 0x00, 0x00, 0x00
};

class SmartButton {
 public:
   const uint8_t pin;
   SmartButton(uint8_t p) : pin(p) {}

   int update() {
     bool isPressing = !digitalRead(pin); 
     int result = 0;
     if (isPressing != pressed && (millis() - lastDebounceTime > debounceTime)) {
       lastDebounceTime = millis();
       pressed = isPressing;
       if (pressed) {
         pressStartTime = millis();
         longPressTriggered = false;
         result = 1; 
       } else {
         result = 2; 
       }
     }
     if (pressed && !longPressTriggered && (millis() - pressStartTime > 1000)) {
        longPressTriggered = true;
        result = 3; 
     }
     return result; 
   }

 private:
   const unsigned long debounceTime = 30;
   unsigned long lastDebounceTime = 0;
   unsigned long pressStartTime = 0;
   bool pressed = false;
   bool longPressTriggered = false;
};

SmartButton buttons[] = {
 SmartButton(BUTTON_PIN1), SmartButton(BUTTON_PIN2), SmartButton(BUTTON_PIN3),
 SmartButton(BUTTON_PIN4), SmartButton(BUTTON_PIN5), SmartButton(BUTTON_PIN6)
};

void updateDisplay(int profileIndex) {
  display.clearDisplay();
  
  display.setTextSize(1);
  display.setTextColor(WHITE);
  display.setCursor(35, 6); 
  display.print("MACRO PAD");

  display.drawRect(0, 16, SCREEN_WIDTH, 48, WHITE);

  display.setTextSize(1);
  display.setCursor(55, 24); 
  display.print("PROFILE:");

  display.setTextSize(2);
  display.setCursor(55, 36); 

  switch (profileIndex) {
    case 0:
      display.drawBitmap(10, 24, icon_game, 32, 32, WHITE);
      display.print("GAME");
      break;
    case 1:
      display.drawBitmap(10, 24, icon_work, 32, 32, WHITE);
      display.print("WORK");
      break;
    case 2:
      display.drawBitmap(10, 24, icon_art, 32, 32, WHITE);
      display.print("Social");
      break;
  }
  display.display();
}

void setup() {
  Serial.begin(9600);
  Consumer.begin(); 
  // Keyboard.begin() удален, он нам больше не нужен!

  for (int i = 0; i < 6; i++) {
    pinMode(buttons[i].pin, INPUT_PULLUP);
  }

  if(!display.begin(SSD1306_SWITCHCAPVCC, 0x3C)) { 
    for(;;); 
  }

  display.clearDisplay();
  display.setTextSize(1);
  display.setTextColor(WHITE);
  display.setCursor(28, 6);
  display.print("SYSTEM START");
  display.setTextSize(2);
  display.setCursor(22, 26); 
  display.print("WELCOME");
  display.setTextSize(1);
  display.setCursor(16, 48);
  display.print("Booting up...");
  display.display();
  
  delay(2000); 
  updateDisplay(currentProfile);
}

void loop() {
  // --- ЛОГИКА ГРОМКОСТИ ---
  static int smoothedPotValue = 0;
  smoothedPotValue = (smoothedPotValue * 9 + analogRead(POT_PIN)) / 10;
  int volumeLevel = map(smoothedPotValue, 0, 1023, 0, 50); 
  static int previousVolume = -1;
  
  if (previousVolume == -1) previousVolume = volumeLevel;

  if (volumeLevel != previousVolume) {
    while (volumeLevel > previousVolume) {
      Consumer.write(MEDIA_VOLUME_UP); 
      previousVolume++; delay(15); 
    }
    while (volumeLevel < previousVolume) {
      Consumer.write(MEDIA_VOLUME_DOWN); 
      previousVolume--; delay(15);
    }
  }

  // --- ЛОГИКА КНОПОК ---
  for (int i = 0; i < 6; i++) {
    int state = buttons[i].update();
   
    if (state == 1) { 
        // ТОЛЬКО отправка команды в Python! Никаких Keyboard.press!
        Serial.print("ACTION:"); 
        Serial.print(currentProfile); 
        Serial.print(":"); 
        Serial.println(i);
    } 
    // Блок else if (state == 2) полностью удален, так как отпускать клавиши больше не нужно
    
    else if (state == 3) { 
        // ДОЛГОЕ НАЖАТИЕ 6-Й КНОПКИ ДЛЯ СМЕНЫ ПРОФИЛЯ
        if (i == 0) { 
            currentProfile++; 
            if (currentProfile >= NUM_PROFILES) {
                currentProfile = 0; 
            }
            updateDisplay(currentProfile);
            
            // Также сообщаем Python, что профиль сменился аппаратно
            Serial.print("REQ:"); 
            Serial.println(currentProfile);
        }
    }
  }
  delay(10); 
}
